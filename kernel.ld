/* kernel.ld */
ENTRY(_start) /* 最初に実行するのは entry.S の _start ラベルだぞという指示 */

SECTIONS
{
    /* ここが重要！QEMUのメモリ開始位置 0x80000000 に合わせる */
    . = 0x80000000;

    /* 機械語（プログラム本体）を置く */
    .text : {
        *(.text)
    }

    /* 読み書きするデータを置く */
    .data : {
        *(.data)
    }

    /* 初期化されていない変数を置く（スタックなど） */
    .bss : {
        *(.bss)
    }
}
